## prj.conf
```kconfig
# Copyright 2019 The TensorFlow Authors. All Rights Reserved.
#
# Licensed under the Apache License, Version 2.0 (the "License");
# you may not use this file except in compliance with the License.
# You may obtain a copy of the License at
#
#    http://www.apache.org/licenses/LICENSE-2.0
#
# Unless required by applicable law or agreed to in writing, software
# distributed under the License is distributed on an "AS IS" BASIS,
# WITHOUT WARRANTIES OR CONDITIONS OF ANY KIND, either express or implied.
# See the License for the specific language governing permissions and
# limitations under the License.
# ==============================================================================s
CONFIG_CPP=y
CONFIG_STD_CPP17=y
CONFIG_TENSORFLOW_LITE_MICRO=y
CONFIG_REQUIRES_FULL_LIBC=y 
#CONFIG_TENSORFLOW_LITE_MICRO_CMSIS_NN_KERNELS=y  #to use CMSIS-NN kernels (only available for ARM Cortex-M)

#cmsis preprocessing
# CONFIG_REQUIRES_FLOAT_PRINTF=y
CONFIG_CMSIS_DSP=y
CONFIG_CMSIS_DSP_TRANSFORM=y
CONFIG_CMSIS_DSP_STATISTICS=y
CONFIG_CMSIS_DSP_BASICMATH=y
CONFIG_CMSIS_DSP_COMPLEXMATH=y
CONFIG_CMSIS_DSP_MATRIX=y

#mic
CONFIG_ADC=y
#CONFIG_ADC_ASYNC=y

CONFIG_USB_DEVICE_INITIALIZE_AT_BOOT=y
CONFIG_TEST_RANDOM_GENERATOR=y
CONFIG_MAIN_STACK_SIZE=4096
```

## src/main.c
```c
#include <zephyr/kernel.h>
#include <zephyr/sys/clock.h>
// #include <zephyr/drivers/timer/system_timer.h>
#include <stdio.h>
#include "constants.h"
#include "mic_functions.h"
#include "tflm_functions.h"

arm_status status;
arm_mfcc_instance_f32 mfcc_inst;

//base,idx,input_normalised[],temp,mfcc_frame[],

void mfcc_init(void);
void get_mfcc_frame(float *input, float *output);
void get_spectrogram(uint16_t input[16000], float output[125][13]);

uint16_t samples[16000];
float32_t spectrogram[125][13];
volatile float32_t input_normalised[256]; 
volatile float32_t mfcc_frame[256];
// float32_t temp[258];
volatile int base;
volatile int idx;
    
int main(void){
    k_sleep(K_MSEC(5000));
    init_mic();
    
    mfcc_init();
    // status = arm_mfcc_init_f32(&mfcc_inst, mfcc_init_fftLen, nbMelFilters, nbDctOutputs, dctCoefs, filterPos, filterLengths, filterCoefs, windowCoefs);
    // if (status != ARM_MATH_SUCCESS) {
    //     printf("init failed!\n");
    //     while(1){}; 
    // }
    // printf("mfcc init success\n");
    
    while(1){
        printf("recording in 3..\n");
        //k_busy_wait(1000000);
        k_sleep(K_MSEC(1000));
        printf("recording in 2..\n");
        k_sleep(K_MSEC(1000));
        // k_busy_wait(1000000);
        printf("recording in 1..\n");
        k_sleep(K_MSEC(1000));
        // k_busy_wait(1000000);
        printf("start speaking..\n");
        
        sample_audio_int(samples, 16000, 1);

        // printf("start sampling\n");
        // for (uint16_t i=0; i<16000; i+=2){
        //     k_usleep(100);
        //     processed_samples[i] = read_mic();
        // }
        // for (uint16_t i=0; i<16000; i+=2){
        //     processed_samples[i+1]=processed_samples[i]; //duplicate alternate samples to emulate 16kHz
        // }
        
        printf("Recording done\n");
        
        get_spectrogram(samples, spectrogram); 
        // for (int i = 0; i < 125; i++) {
        //     int base = i * 128;
        //     for (int j = 0; j < 256; j++) {
        //         int idx=base+j;
        //         input_normalised[j] = (idx < 16000) ? (float)(processed_samples[idx]/32768.0f - 1.0f) : 0.0f;
        //         //if(i==124) printf("%d ",round(input_normalised[i]));
        //     }
        //     printf("frame: %d start\n", i);
        //     if (i==124) printf("c1\n");
        //     //get_mfcc_frame(input_normalised, mfcc_frame);
        //     arm_mfcc_f32(&mfcc_inst, input_normalised, mfcc_frame, temp);
        //     //memset(input_normalised, 0, sizeof(input_normalised));  
        //     if (i==124) printf("c2\n");
        //     for (int j = 0; j < 13; j++) {
        //         spectrogram[i][j] = mfcc_frame[j];
        //     }   
        //     printf("frame: %d\n end", i);
        // }
        
                
        printk("start inference\n");

        perform_inference(spectrogram);

        k_sleep(K_MSEC(5000));
    }

    return 0;
}


void mfcc_init(void){
    status = arm_mfcc_init_f32(&mfcc_inst, mfcc_init_fftLen, nbMelFilters, nbDctOutputs, dctCoefs, filterPos, filterLengths, filterCoefs, windowCoefs);
    if (status != ARM_MATH_SUCCESS) {
        printf("init failed!\n");
        while(1){}; 
    }
    printf("mfcc init success\n");
}


//input: one frame of samples     output: one frame of mfcc
// void get_mfcc_frame(float *input, float *output){   //for knowledge: alternate void get_mfcc_frame(float *input, float *output, int input_len, int output_len)
//     arm_mfcc_f32(&mfcc_inst, input, output, temp);
// }

//base,idx,input_normalised[],temp,mfcc_frame[],
void get_spectrogram(uint16_t input[16000], float output[125][13]){
    for (int i = 0; i < 125; i++) {
        base = i * 128;
        for (int j = 0; j < 256; j++) {
            idx=base+j;
            input_normalised[j] = (idx < 16000) ? (float)(input[idx]/32768.0f - 1.0f) : 0.01f;
            printk("%d ",(int)round(input_normalised[j]*10000.0f));
        }
        
        arm_mfcc_f32(&mfcc_inst, input_normalised, mfcc_frame, temp); 
        if (i==124) printf("check mfcc\n");
        for (int k = 0; k < 13; k++) {
            output[i][k] = mfcc_frame[k];
        }   
        printf("frame: %d end\n", i);
    }
}
```

## src/mic_functions.c
```c
/*
 * Copyright (c) 2020 Libre Solar Technologies GmbH
 *
 * SPDX-License-Identifier: Apache-2.0
 */

#include <inttypes.h>
#include <stddef.h>
#include <stdint.h>

#include <zephyr/device.h>
#include <zephyr/devicetree.h>
#include <zephyr/drivers/adc.h>
#include <zephyr/kernel.h>
#include <zephyr/sys/printk.h>
#include <zephyr/sys/util.h>
#include "mic_functions.h"

#include <zephyr/drivers/timer/system_timer.h>
#include <zephyr/sys/clock.h>
#include <zephyr/sys/time_units.h>

//safety check to see if zephyr_user is defined and io_channels is mentioned
#if !DT_NODE_EXISTS(DT_PATH(zephyr_user)) || \
	!DT_NODE_HAS_PROP(DT_PATH(zephyr_user), io_channels)
#error "No suitable devicetree overlay specified"
#endif

#define DT_SPEC_AND_COMMA(node_id, prop, idx) \
	ADC_DT_SPEC_GET_BY_IDX(node_id, idx),

/* Data of ADC io-channels specified in devicetree. */
static const struct adc_dt_spec adc_channels[] = {
	DT_FOREACH_PROP_ELEM(DT_PATH(zephyr_user), io_channels,
			     DT_SPEC_AND_COMMA)
};


int err;
uint16_t buf;
// int32_t val_mv;
struct adc_sequence sequence = {
	.buffer = &buf,
	/* buffer size in bytes, not number of samples */
	.buffer_size = sizeof(buf),
};

//struct 	k_poll_signal adc_signal;

uint16_t init_mic(void)
{
	if (!adc_is_ready_dt(&adc_chan	nels[0])) {
		printk("ADC controller device %s not ready\n", adc_channels[0].dev->name);
		return 0;
	}

	err = adc_channel_setup_dt(&adc_channels[0]);
	if (err < 0) {
		printk("Could not setup channel #%d (%d)\n", 0, err);
		return 0;
	}
	printk("mic init success\n");
	
	(void)adc_sequence_init_dt(&adc_channels[0], &sequence);
	return 0;
}

uint16_t read_mic(void){

	// (void)adc_sequence_init_dt(&adc_channels[0], &sequence);

	err = adc_read_dt(&adc_channels[0], &sequence);
	//err = adc_read_async(&adc_channels[0], &sequence, &adc_signal);
	if (err < 0) {
		printk("Could not read (%d)\n", err);
	}
	return buf;

}

//for sampling of audio (can work for upto ~4 seconds)
void sample_audio_int(uint16_t *out, int samp_rate, int time){
	// // int32_t t_i,delta;
	// // int32_t samp_delay = 1000000/samp_rate;  //us delay between samples for 16kHz
	// uint16_t iters=samp_rate*time;

	// printf("start sampling\n");
	// for (uint16_t i=0; i<iters; i+=2){
	// 	k_usleep(100);
	// 	out[i] = read_mic();
	// 	// out[i+1]=out[i]; //duplicate alternate samples to emulate 16kHz
	// 	//k_busy_wait(20);
	// }
	// for (uint16_t i=0; i<iters; i+=2){
	// 	out[i+1]=out[i]; //duplicate alternate samples to emulate 16kHz
	// }

	// // LOG_INF("end sampling");
	// printk("end sampling\n");

	int32_t t_i;
	int32_t samp_delay = 1000000/samp_rate;  //us delay between samples for 16kHz
	uint16_t iters=samp_rate*time;
	printk("check mic\n");
	// LOG_INF("check mic");
	
	uint32_t start_cycles = k_cycle_get_32();
	out[0] = read_mic(); 
	uint32_t delta_cycles = k_cycle_get_32() - start_cycles;
	uint32_t delay_time = k_cyc_to_us_floor32((uint64_t)delta_cycles);

	printk("delay time: %d us\n", delay_time);

	// LOG_INF("start sampling");
	printk("start sampling\n");
	for (uint16_t i=1; i<iters; i++){
		//k_usleep(100);
		k_usleep(100);
		out[i] = read_mic();
	}
	// LOG_INF("end sampling");
	printk("end sampling\n");
}
```

## src/model_data_small.hpp
```c
#ifndef MODEL_DATA_SMALL_H
#define MODEL_DATA_SMALL_H

extern const unsigned char model_data_small[];
extern const int model_data_small_len;

#endif 
```

## src/tflm_functions.h
```c
#ifndef TFLM_FUNCTIONS_H
#define TFLM_FUNCTIONS_H

#include <stdint.h>

#ifdef __cplusplus
extern "C" {
#endif

void perform_inference(float in[125][13]);

#ifdef __cplusplus
}
#endif

#endif
```
