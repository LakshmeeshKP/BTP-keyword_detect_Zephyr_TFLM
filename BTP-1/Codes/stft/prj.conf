## prj.conf
```kconfig
CONFIG_CPP=y
CONFIG_STD_CPP17=y
CONFIG_REQUIRES_FLOAT_PRINTF=y
CONFIG_USB_DEVICE_INITIALIZE_AT_BOOT=y
CONFIG_TEST_RANDOM_GENERATOR=y
CONFIG_MAIN_STACK_SIZE=2048
```

## src/main.c
```c
#include <stdio.h>
#include <math.h>
#include <zephyr/kernel.h>
#include <zephyr/random/random.h>
#include "tools/kiss_fftr.h"
#include "FFTconstants.h"
#include "stft_lkp.h"

#define CFG_BUFFER_SIZE 3000

char fft_cfg_buffer[CFG_BUFFER_SIZE];
size_t fft_cfg_buffer_len = CFG_BUFFER_SIZE;

float spectrogram[124][129];

stft_lkp_cfg stft_cfg;

int main(void){
    // printf("start");
    k_sleep(K_MSEC(3000));
    stft_init(&stft_cfg, 256, 128, 16000, hann, fft_cfg_buffer, &fft_cfg_buffer_len);
    // stft_init(&stft_cfg, 256, 64, 8000, hann, fft_cfg_buffer, &fft_cfg_buffer_len);

    stft(&stft_cfg, audio_samples, spectrogram);  

    for(int i=0; i<124; i++){
        printf("Frame %d: ", i);
        print_array(spectrogram[i], 129);
    }

    stft_free(&stft_cfg);
    return 0;
}
```

## src/stft_lkp.h
```c
/*
Note: 
Assumptions made:
1.audio input is 1sec long 
2.input datatype is int16 with range [-32768,32767].
*/

#ifndef STFT_LKP_H
#define STFT_LKP_H

#include <stdint.h>
#include "tools/kiss_fftr.h"

typedef struct {
    int fft_size;       
    int hop_size;       
    int sample_rate;    
    float *window;
    kiss_fftr_cfg cfg;  
    kiss_fft_cpx* out_buffer;
    float* in_buffer;
} stft_lkp_cfg;


void print_array(float arr[], int size);

// Initializer
void stft_init(stft_lkp_cfg *stft_cfg, int fft_size, int hop_size, int sample_rate, float window[], char fft_cfg_buffer[], size_t *fft_cfg_buffer_len);

// STFT computation
void stft(stft_lkp_cfg *stft_cfg, const int *samples, float *output);

//deallocate buffers
void stft_free(stft_lkp_cfg *stft_cfg);

#endif 
```
