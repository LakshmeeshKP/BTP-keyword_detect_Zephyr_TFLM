## BTP-1/Codes/Board_file_picoW/rpi_pico_rp2040_w/Kconfig
```kconfig
# Copyright (c) 2021 Yonatan Schachter
# SPDX-License-Identifier: Apache-2.0

config BOARD_RPI_PICO_RP2040_W
	#bool "Raspberry Pi Pico RP2040 W"
	#select SOC_RP2040
	select RP2_FLASH_W25Q080
```

## BTP-1/Codes/Board_file_picoW/rpi_pico_rp2040_w/board.yml
```yaml
board:
  name: rpi_pico_rp2040_w
  full_name: Raspberry Pi Pico
  vendor: raspberrypi
  socs:
  - name: rp2040
    variants:
    - name: w
```
